/* PLRv1.keymap */
#include <behaviors.dtsi>
#include <dt-bindings/zmk/keys.h>
#include <dt-bindings/zmk/bt.h>

&keymap {
    compatible = "zmk,keymap";
    label = "plrv1";

    bindings = <
        &kp Q     &kp W     &kp E     &kp R     &none    &none    &none    &none    &none    &none
        &kp A     &kp S     &kp D     &kp F     &kp G    &kp H    &kp J    &kp K    &kp L    &none
        &kp Z     &kp X     &kp C     &kp V     &kp B    &kp N    &kp M    &kp COMM &kp DOT &kp ENT
        &kp TAB   &kp ESC   &kp LCTL  &kp LALT  &kp SPC  &kp LEFT &kp DOWN &kp UP   &kp RGHT &kp BSPC
        &kp NUM   &kp 1     &kp 2     &kp SPC   &kp 3    &kp 4    &kp 5    &none    &none    &none
    >;
};