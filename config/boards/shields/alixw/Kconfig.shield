## config/boards/shields/dilly/Kconfig.defconfig
```kconfig
# Copyright (c) 2021 purple-rw
# SPDX-License-Identifier: MIT

if SHIELD_PLRV1

config ZMK_KEYBOARD_NAME
    default "Plrv1"

endif

if ZMK_BACKLIGHT

config PWM
    default y

config LED_PWM
    default y

endif # ZMK_BACKLIGHT
```

## config/shields/dilly/Kconfig.shield
```kconfig
# Copyright (c) 2021 purple-rw
# SPDX-License-Identifier: MIT

config SHIELD_PLRV1
    def_bool $(shields_list_contains,plrv1)
```
